/******************************************************************************
	          中景园电子  MSP430F5438A 

功能：测试MSP430F5438A-四个LED

硬件原理图：  LED1    -->   P1.3
              LED2    -->   P1.4
              LED3    -->   P1.5
              LED4    -->   P1.6

说明：不用循环延时，使用IAR编译软件自带稍微精准的延时，推荐使用

编译环境：IAR5.3
Time：2018、8、1

中景园电子
淘宝店铺：https://shop73023976.taobao.com
******************************************************************************/
#include <msp430F5438A.h>           //头文件

void delay(unsigned int i);

void main(void)                   //主函数 
{ 
  WDTCTL = WDTPW + WDTHOLD;       //关闭看门狗 
  
  P1DIR |= BIT3;  //P1.3设置为输出，P8与第0位（与1相与等于1，其他位不变）
  P1DIR |= BIT4;  //P1.4设置为输出，P8与第1位（与1相与等于1，其他位不变）
  P1DIR |= BIT5;  //P1.5设置为输出，P8与第1位（与1相与等于1，其他位不变）
  P1DIR |= BIT6;  //P1.6设置为输出，P8与第1位（与1相与等于1，其他位不变）
  
  P1OUT &= ~BIT3;  //P1.3 = 0，LED灭
  P1OUT &= ~BIT4;  //P1.4 = 0，LED灭
  P1OUT &= ~BIT5;  //P1.5 = 0，LED灭
  P1OUT &= ~BIT6;  //P1.6 = 0，LED灭
  
  delay(1000);
  delay(1000);

  while(1) 
  { 
    P1OUT &= ~BIT3;  //P1.3 = 0，LED灭
    P1OUT &= ~BIT4;  //P1.4 = 0，LED灭
    P1OUT &= ~BIT5;  //P1.5 = 0，LED灭
    P1OUT &= ~BIT6;  //P1.6 = 0，LED灭
    delay(1000);
    P1OUT |= BIT3;   //P1.3 = 1，LED亮
    P1OUT |= BIT4;   //P1.4 = 1，LED亮
    P1OUT |= BIT5;   //P1.5 = 1，LED亮
    P1OUT |= BIT6;   //P1.6 = 1，LED亮
    delay(1000);
  } 
} 

/******************************************************************************
函数功能：延时
返回值：  无
******************************************************************************/
void delay(unsigned int i)
{
  unsigned int x, y;
  
  for(x=i; x>0; x--)
    for(y=100; y>0; y--)
      _NOP();
}